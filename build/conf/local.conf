## build/conf/local.conf
```bitbake
MACHINE ??= 'dm421'
DISTRO ?= 'fsl-imx-xwayland'
PACKAGE_CLASSES ?= 'package_rpm'
EXTRA_IMAGE_FEATURES ?= "debug-tweaks"
USER_CLASSES ?= "buildstats"
PATCHRESOLVE = "noop"
BB_DISKMON_DIRS ??= "\
    STOPTASKS,${TMPDIR},1G,100K \
    STOPTASKS,${DL_DIR},1G,100K \
    STOPTASKS,${SSTATE_DIR},1G,100K \
    STOPTASKS,/tmp,100M,100K \
    HALT,${TMPDIR},100M,1K \
    HALT,${DL_DIR},100M,1K \
    HALT,${SSTATE_DIR},100M,1K \
    HALT,/tmp,10M,1K"
PACKAGECONFIG:append:pn-qemu-system-native = " sdl"
CONF_VERSION = "2"

DL_DIR ?= "${BSPDIR}/downloads/"
ACCEPT_FSL_EULA = "1"

# Switch to Debian packaging and include package-management in the image
PACKAGE_CLASSES = "package_deb"
EXTRA_IMAGE_FEATURES += "package-management"
CORE_IMAGE_EXTRA_INSTALL += "chromium-ozone-wayland"
CORE_IMAGE_EXTRA_INSTALL += "dotnet-core"
CORE_IMAGE_EXTRA_INSTALL += "vsdbg"

IMAGE_INSTALL:append = " \
    expand-rootfs \
    linux-firmware \
    gnupg \
    packagegroup-core-ssh-openssh \
    openssh-sftp-server \
    xrandr \
    xdpyinfo \
    fontconfig \
"

INHERIT += "rm_work"

# Switch to Debian packaging and include package-management in the image
PACKAGE_CLASSES = "package_deb"
EXTRA_IMAGE_FEATURES += "package-management"
```

## sources/meta-custom-dmp/conf/layer.conf
```bitbake
# We have a conf and classes directory, add to BBPATH
BBPATH .= ":${LAYERDIR}"

# We have a packages directory, add to BBFILES
BBFILES += "${LAYERDIR}/recipes-${MACHINE_ARCH}/*/*.bb \
            ${LAYERDIR}/recipes-${MACHINE_ARCH}/*/*.bbappend \
            ${LAYERDIR}/recipes-dmp/*/*.bb \
            ${LAYERDIR}/recipes-dmp/*/*.bbappend" 

BBFILE_COLLECTIONS += "meta-custom-dmp"
BBFILE_PATTERN_meta-custom-dmp := "^${LAYERDIR}/"
BBFILE_PRIORITY_meta-custom-dmp = "8"
LAYERSERIES_COMPAT_meta-custom-dmp = "kirkstone"
```

## sources/meta-istran/conf/machine/dm421.conf
```bitbake
#@TYPE: Machine
#@NAME: NXP i.MX8MM DDR4 Evaluation Kit
#@SOC: i.MX8MM
#@DESCRIPTION: Machine configuration for NXP i.MX8MMini DDR4 dm421
#@MAINTAINER: Jun Zhu <junzhu@nxp.com>

MACHINEOVERRIDES =. "mx8:mx8m:mx8mm:"

require conf/machine/include/imx-base.inc
require conf/machine/include/arm/armv8a/tune-cortexa53.inc

MACHINE_FEATURES += " pci wifi bluetooth bcm43430"

KERNEL_DEVICETREE = "freescale/imx8mm-dm421.dtb"

UBOOT_CONFIG ??= "sd"
UBOOT_CONFIG[sd] = "imx8mm_dm421_defconfig,sdcard"
UBOOT_CONFIG[mfgtool] = "imx8mm_dm421_defconfig"
UBOOT_DEVICETREE = "imx8mm-dm421"
SPL_BINARY = "spl/u-boot-spl.bin"

IMX_DEFAULT_SOC = "imx8mm"
ATF_PLATFORM = "imx8mm"

IMX_BOOT_SOC_TARGET = "iMX8MM"

# Set DDR FIRMWARE
DDR_FIRMWARE_NAME = "lpddr4_pmu_train_1d_imem.bin lpddr4_pmu_train_1d_dmem.bin lpddr4_pmu_train_2d_imem.bin lpddr4_pmu_train_2d_dmem.bin"

# Set u-boot DTB
UBOOT_DTB_NAME = "imx8mm-dm421.dtb"

# Set imx-mkimage boot target
IMXBOOT_TARGETS = "${@bb.utils.contains('UBOOT_CONFIG', 'fspi', 'flash_evk_flexspi', 'flash_evk', d)}"

# Set Serial console
SERIAL_CONSOLES = "115200;ttymxc1"

IMAGE_BOOTLOADER = "imx-boot"

LOADADDR = ""
UBOOT_SUFFIX = "bin"
UBOOT_MAKE_TARGET = ""
IMX_BOOT_SEEK = "33"

OPTEE_BIN_EXT = "8mm"
```
